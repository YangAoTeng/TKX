// filepath: c:\Users\q8979\Desktop\TKX\TKX_EEPROM\Src\IIC_OLED.c

#include "IIC_OLED.h"
#include "i2c.h"
#include <stdio.h>
#include <stdlib.h>
#include <string.h>

// 外部I2C句柄声明，假设I2C1被用于OLED通信
extern I2C_HandleTypeDef hi2c1;

/*OLED字模库，宽8像素，高16像素*/
const uint8_t OLED_F8x16[][16]=
{
	0x00,0x00,0x00,0x00,0x00,0x00,0x00,0x00,
	0x00,0x00,0x00,0x00,0x00,0x00,0x00,0x00,//  0
	
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	0x00,0x00,0x00,0x00,0x00,0x00,0x00,0x00,//~ 94
};

/**
 * @brief  向OLED写入命令
 * @param  cmd: 要写入的命令
 * @retval HAL状态
 */
HAL_StatusTypeDef OLED_Write_Cmd(uint8_t cmd)
{
    uint8_t buffer[2];
    buffer[0] = OLED_CMD;    // 命令控制字节
    buffer[1] = cmd;         // 命令字节
    
    return HAL_I2C_Master_Transmit(&hi2c1, OLED_ADDR, buffer, 2, OLED_I2C_TIMEOUT);
}

/**
 * @brief  向OLED写入数据
 * @param  data: 要写入的数据
 * @retval HAL状态
 */
HAL_StatusTypeDef OLED_Write_Data(uint8_t data)
{
    uint8_t buffer[2];
    buffer[0] = OLED_DATA;   // 数据控制字节
    buffer[1] = data;        // 数据字节
    
    return HAL_I2C_Master_Transmit(&hi2c1, OLED_ADDR, buffer, 2, OLED_I2C_TIMEOUT);
}

/**
 * @brief  初始化OLED
 */
void OLED_Init(void)
{
    HAL_Delay(100);  // 等待OLED稳定
    
    // 初始化SSD1306
    OLED_Write_Cmd(0xAE);    // 关闭显示
    OLED_Write_Cmd(0xD5);    // 设置显示时钟分频比/振荡器频率
    OLED_Write_Cmd(0x80);    // 设置分频比，设置时钟为100帧/秒
    OLED_Write_Cmd(0xA8);    // 设置多路复用率
    OLED_Write_Cmd(0x3F);    // 1/64 duty
    OLED_Write_Cmd(0xD3);    // 设置显示偏移
    OLED_Write_Cmd(0x00);    // 不偏移
    OLED_Write_Cmd(0x40);    // 设置显示开始行 [5:0]
    OLED_Write_Cmd(0x8D);    // 电荷泵设置
    OLED_Write_Cmd(0x14);    // 启用电荷泵
    OLED_Write_Cmd(0x20);    // 设置内存地址模式
    OLED_Write_Cmd(0x02);    // 页地址模式
    OLED_Write_Cmd(0xA1);    // 段重定义设置，0xA1正常，0xA0左右反置
    OLED_Write_Cmd(0xC8);    // 设置COM扫描方向，0xC8正常，0xC0上下反置
    OLED_Write_Cmd(0xDA);    // 设置COM硬件引脚配置
    OLED_Write_Cmd(0x12);    // [5:4] COM引脚配置
    OLED_Write_Cmd(0x81);    // 对比度设置
    OLED_Write_Cmd(0xCF);    // 设置对比度为0xCF
    OLED_Write_Cmd(0xD9);    // 设置预充电周期
    OLED_Write_Cmd(0xF1);    // [3:0],PHASE 1;[7:4],PHASE 2;
    OLED_Write_Cmd(0xDB);    // 设置VCOMH电压倍率
    OLED_Write_Cmd(0x30);    // [6:4] 000,0.65*vcc;001,0.77*vcc;011,0.83*vcc;
    OLED_Write_Cmd(0xA4);    // 全局显示开启;0xA4,开启;0xA5,关闭;
    OLED_Write_Cmd(0xA6);    // 设置显示方式;0xA6,正常显示;0xA7,反相显示;
    OLED_Write_Cmd(0xAF);    // 开启显示
    
    OLED_Clear();            // 清屏
}

/**
 * @brief  清屏
 */
void OLED_Clear(void)
{
    uint8_t i, n;
    
    for(i = 0; i < OLED_PAGE_NUM; i++)
    {
        OLED_SetPos(0, i);
        for(n = 0; n < OLED_WIDTH; n++)
        {
            OLED_Write_Data(0x00);
        }
    }
}

/**
 * @brief  打开OLED显示
 */
void OLED_Display_On(void)
{
    OLED_Write_Cmd(0x8D);    // 电荷泵设置
    OLED_Write_Cmd(0x14);    // 启用电荷泵
    OLED_Write_Cmd(0xAF);    // 开启显示
}

/**
 * @brief  关闭OLED显示
 */
void OLED_Display_Off(void)
{
    OLED_Write_Cmd(0x8D);    // 电荷泵设置
    OLED_Write_Cmd(0x10);    // 禁用电荷泵
    OLED_Write_Cmd(0xAE);    // 关闭显示
}

/**
 * @brief  设置光标位置
 * @param  x: X坐标 (0~127)
 * @param  y: Y坐标 (0~7)
 */
void OLED_SetPos(uint8_t x, uint8_t y)
{
    OLED_Write_Cmd(0xB0 + y);                    // 设置页地址 (0~7)
    OLED_Write_Cmd(0x00 + (x & 0x0F));           // 设置显示位置—列低地址
    OLED_Write_Cmd(0x10 + ((x & 0xF0) >> 4));    // 设置显示位置—列高地址
}

/**
 * @brief  画点
 * @param  x: X坐标 (0~127)
 * @param  y: Y坐标 (0~63)
 * @param  mode: 0,清除;1,填充
 */
void OLED_DrawPoint(uint8_t x, uint8_t y, uint8_t mode)
{
    uint8_t pos, bx, temp = 0;
    
    if(x > OLED_WIDTH - 1 || y > OLED_HEIGHT - 1)
        return;
    
    pos = y / 8;             // 得到页位置
    bx = y % 8;              // 得到页内位置
    temp = 1 << bx;          // 得到点对应的位
    
    OLED_SetPos(x, pos);
    
    if(mode)
        OLED_Write_Data(temp);   // 画点
    else
        OLED_Write_Data(0);      // 清点
}

/**
 * @brief  显示字符
 * @param  x: X坐标 (0~127)
 * @param  y: Y坐标 (0~7)
 * @param  chr: 要显示的字符
 * @param  size: 字体大小 (16/12)
 * @param  mode: 0,反白显示;1,正常显示
 */
void OLED_ShowChar(uint8_t x, uint8_t y, char chr, uint8_t size, uint8_t mode)
{
    uint8_t c = 0, i = 0;
    
    c = chr - ' ';  // 得到偏移后的值
    
    if(x > OLED_WIDTH - 1 || y > OLED_PAGE_NUM - 1)
        return;
    
    if(size == 16)
    {
        OLED_SetPos(x, y);
        for(i = 0; i < 8; i++)
        {
            if(mode)
                OLED_Write_Data(OLED_F8x16[c][i]);
            else
                OLED_Write_Data(~OLED_F8x16[c][i]);
        }
        
        OLED_SetPos(x, y+1);
        for(i = 0; i < 8; i++)
        {
            if(mode)
                OLED_Write_Data(OLED_F8x16[c][i+8]);
            else
                OLED_Write_Data(~OLED_F8x16[c][i+8]);
        }
    }
    else
    {
        // 暂不支持其他字体大小
    }
}

/**
 * @brief  显示字符串
 * @param  x: X坐标 (0~127)
 * @param  y: Y坐标 (0~7)
 * @param  str: 要显示的字符串
 * @param  size: 字体大小 (16/12)
 * @param  mode: 0,反白显示;1,正常显示
 */
void OLED_ShowString(uint8_t x, uint8_t y, const char *str, uint8_t size, uint8_t mode)
{
    uint8_t j = 0;
    
    if(x > OLED_WIDTH - 1 || y > OLED_PAGE_NUM - 1)
        return;
    
    while(str[j] != '\0')
    {
        OLED_ShowChar(x, y, str[j], size, mode);
        if(size == 16)
        {
            x += 8;
            if(x > OLED_WIDTH - 8)
            {
                x = 0;
                y += 2;
            }
        }
        j++;
    }
}

/**
 * @brief  显示数字
 * @param  x: X坐标 (0~127)
 * @param  y: Y坐标 (0~7)
 * @param  num: 要显示的数字
 * @param  len: 数字长度
 * @param  size: 字体大小 (16/12)
 * @param  mode: 0,反白显示;1,正常显示
 */
void OLED_ShowNum(uint8_t x, uint8_t y, uint32_t num, uint8_t len, uint8_t size, uint8_t mode)
{
    uint8_t t, temp;
    uint8_t enshow = 0;
    
    for(t = 0; t < len; t++)
    {
        temp = (num / (uint32_t)pow(10, len - t - 1)) % 10;
        if(enshow == 0 && t < (len - 1))
        {
            if(temp == 0)
            {
                OLED_ShowChar(x + (size/2) * t, y, ' ', size, mode);
                continue;
            }
            else
                enshow = 1;
        }
        OLED_ShowChar(x + (size/2) * t, y, temp + '0', size, mode);
    }
}

/**
 * @brief  显示BMP图片
 * @param  x0: 起始X坐标 (0~127)
 * @param  y0: 起始Y坐标 (0~7)
 * @param  x1: 终止X坐标 (0~127)
 * @param  y1: 终止Y坐标 (0~7)
 * @param  BMP: 要显示的BMP图片
 */
void OLED_DrawBMP(uint8_t x0, uint8_t y0, uint8_t x1, uint8_t y1, const uint8_t *BMP)
{
    uint8_t x, y;
    
    if(x0 > OLED_WIDTH - 1 || y0 > OLED_PAGE_NUM - 1 || x1 > OLED_WIDTH - 1 || y1 > OLED_PAGE_NUM - 1)
        return;
    
    for(y = y0; y <= y1; y++)
    {
        OLED_SetPos(x0, y);
        for(x = x0; x <= x1; x++)
        {
            OLED_Write_Data(*BMP++);
        }
    }
}

/**
 * @brief  格式化输出到OLED显示屏
 * @param  x: X坐标 (0~127)
 * @param  y: Y坐标 (0~7)
 * @param  size: 字体大小 (16/12)
 * @param  mode: 0,反白显示;1,正常显示
 * @param  fmt: 格式化字符串，类似于printf
 * @param  ...: 可变参数列表
 */
void OLED_Printf(uint8_t x, uint8_t y, uint8_t size, uint8_t mode, const char *fmt, ...)
{
    char buffer[128];  // 缓冲区
    va_list args;
    
    va_start(args, fmt);
    vsnprintf(buffer, sizeof(buffer), fmt, args);
    va_end(args);
    
    if (x > 127) {
        // 水平居中显示
        uint8_t text_width = strlen(buffer) * (size / 2);  // 计算文本宽度 (每个字符宽度为size/2)
        if (text_width < OLED_WIDTH) {
            x = (OLED_WIDTH - text_width) / 2;  // 计算居中的X坐标
        } else {
            x = 0;  // 如果文本太长，从左边开始显示
        }
    }
    
    OLED_ShowString(x, y, buffer, size, mode);
}